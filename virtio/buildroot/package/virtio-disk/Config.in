## virtio/buildroot/package/virtio-disk/Config.in
```kconfig
config BR2_PACKAGE_VIRTIO_DISK
	bool "virtio disk"
	help
	  This package builds the virtio disk backend.
```

## virtio/buildroot/rockchip_rk3588_defconfig
```kconfig
#include "base.config"
#include "base_extra.config"
#include "rk3588_arm64.config"
#include "npu2.config"

#include "debug.config"

#include "audio.config"
#include "audio_gst.config"
#include "camera.config"
#include "camera_gst.config"
#include "video_mpp.config"
#include "video_gst.config"
#include "video_gst_rtsp.config"

#include "gpu.config"
#include "weston.config"

#include "network.config"
#include "wifi.config"
#include "bt.config"

#include "chromium.config"

#include "test.config"
#include "benchmark.config"

BR2_PACKAGE_UTIL_LINUX=y
BR2_PACKAGE_UTIL_LINUX_LIBS=y
BR2_PACKAGE_UTIL_LINUX_LIBBLKID=y
BR2_PACKAGE_UTIL_LINUX_LIBFDISK=y
BR2_PACKAGE_UTIL_LINUX_LIBMOUNT=y
BR2_PACKAGE_UTIL_LINUX_LIBSMARTCOLS=y
BR2_PACKAGE_UTIL_LINUX_LIBUUID=y
BR2_PACKAGE_UTIL_LINUX_BINARIES=y
BR2_PACKAGE_PKGCONF=y
BR2_PACKAGE_RKWIFIBT_AP6275P=y
BR2_PACKAGE_RKWIFIBT_BTUART="ttyS8
BR2_PACKAGE_XEN=y
BR2_PACKAGE_XEN_HYPERVISOR=y
BR2_PACKAGE_XEN_TOOLS=y
BR2_PACKAGE_MAKE=y
BR2_PACKAGE_LINUX_HEADERS=y
BR2_PACKAGE_SUDO=y
BR2_PACKAGE_VIRTIO_DISK=y
```
